## prj.conf
```kconfig
CONFIG_ZTEST=y
CONFIG_MULTITHREADING=n
CONFIG_BT=n
CONFIG_USB=n

# Running without multithreading implies the lack of MMU support.
# Setting CONFIG_USERSPACE=n alone is not enough to disable userspace.
# The TEST_USERSPACE symbol (designed to enable userspace by default
# on tests platforms that support it) defaults to =y and will
# automatically select it back.
CONFIG_TEST_USERSPACE=n
CONFIG_USERSPACE=n

CONFIG_TEST_SANITY_RETRY=y
```

## src/main.c
```c
/*
 * Copyright (c) 2018 Intel Corporation
 *
 * SPDX-License-Identifier: Apache-2.0
 */
#include <zephyr.h>
#include <ztest.h>

#ifdef CONFIG_BOARD_NATIVE_POSIX
#error Build failure!
#endif

/* The only point to CONFIG_MULTITHREADING=n is to use Zephyr's
 * multiplatform toolchain, linkage and boostrap integration to arrive
 * here so the user can run C code unimpeded.  In general, we don't
 * promise that *any* Zephyr APIs are going to work properly, so don't
 * try to test any.  That means we can't even use the ztest suite
 * framework (which spawns threads internally).
 */
void test_main(void)
{
	TC_PRINT("It works\n");
	TC_END_REPORT(IS_ENABLED(CONFIG_X86) ? TC_FAIL : TC_PASS);
}
```
