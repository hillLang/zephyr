## CMakeLists.txt
```
# SPDX-License-Identifier: Apache-2.0

cmake_minimum_required(VERSION 3.13.1)

include($ENV{ZEPHYR_BASE}/cmake/app/boilerplate.cmake NO_POLICY_SCOPE)
project(hello_world)

target_sources(app PRIVATE src/main.c src/hda.c)
```

## prj.conf
```kconfig
# nothing here
CONFIG_SMP=n
```

## src/main.c
```c
/*
 * Copyright (c) 2012-2014 Wind River Systems, Inc.
 *
 * SPDX-License-Identifier: Apache-2.0
 */

#include <zephyr.h>
#include <sys/printk.h>
#include <platform/shim.h>

#define STACK_SIZE 2048
K_THREAD_STACK_DEFINE(stack, STACK_SIZE);

/* Weirdness with a non-array "first_dword" because -Warray-bounds is
 * too smart and flips out when we calculate the uncached mapping, no
 * matter how hard I try to hide the array.
 */
static __aligned(64) struct {
	u32_t first_dword;
	u32_t rest[15];
} cacheline;

/* Test rig to do an operation through cached/uncached pointers.  Logs
 * what is going to happen, executes it, makes sure the compiler
 * doens't muck with the results, and prints the old and new values
 */
#define CACHEOP(expr) do {						\
		printk("%s\n", #expr);					\
		u32_t u0 = *ucp, c0 = *cp;				\
		__asm__ volatile("" : : : "memory");			\
		expr;							\
		__asm__ volatile("" : : : "memory");			\
		printk(" :: *cp = %d -> %d, *ucp = %d -> %d\n", c0, *cp, u0, *ucp); \
	} while(0)

int __incoherent cached_int;
int __attribute__((__section__(".cached"))) cached2_int;

static int bss_int;

void check_cache(void)
{
        // Check linkage, make sure things are mapped where they
        // should be
        int stack_int;
	printk("&cached_int = %p\n", &cached_int);
	printk("&cached2_int = %p\n", &cached2_int);
        printk("&bss_int = %p\n", &bss_int);
        printk("&stack_int = %p\n", &stack_int);

	for (int region = 0; region < 8; region++) {
		u32_t addr = 0x20000000 * region;
		u32_t attrib;

		__asm__ volatile("rdtlb1 %0, %1" : "=r"(attrib) : "r"(addr));
		printk("region %d @0x%x cachattr 0x%x\n", region, addr, attrib & 0xf);
	}

	/* Cached and uncached pointers to the same value. */
        long addr = (long)&cacheline.first_dword;
	volatile u32_t *cp = (void *)(addr | 0x20000000);
	volatile u32_t *ucp = (void *)(addr & ~0x20000000);

	printk("cp %p ucp %p\n", cp, ucp);

	*cp = *ucp = 0;

	/* Set the cached pointer to 1, only it should show the results */
	CACHEOP(*cp = 1);

	/* Set the uncached pointer, the cached one shouldn't change */
	CACHEOP(*ucp = 2);

	/* Flush the cache from before, BOTH should become 1 */
	CACHEOP(SOC_DCACHE_FLUSH((void*)cp, sizeof(*cp)));

	/* Now prime the cache with a new value, and invalidate it */
	CACHEOP(*cp = 3);
	CACHEOP(SOC_DCACHE_INVALIDATE((void*)cp, sizeof(*cp)));

	/* Write into the underlying memory, make sure cp has it
	 * cached, write one word into the cache, write new values
	 * into the uncached RAM, then flush the cache.  Does the
	 * flush honor the mask of "actually written" memory or does
	 * it write back the previously read (and still unmodified)
	 * data?
	 */
	SOC_DCACHE_INVALIDATE((void*)cp, sizeof(*cp));
	ucp[0] = ucp[1] = 5;  /* Prime RAM with 5's */
	cp[0] = 6;            /* Write a 6 into the cache */
	ucp[0] = ucp[1] = 7;  /* Now RAM is 7's, but cache still {6, 5} */
	SOC_DCACHE_FLUSH((void*)cp, sizeof(*cp));
	if (ucp[1] == 7) {
		printk("Cache is piecewise coherent!\n");
	} else if (ucp[1] == 5) {
		/* This is the truth here.  Sigh. */
		printk("Cache is piecewise INCOHERENT!\n");
	} else {
		printk("Huh?!\n");
	}

}

/* Dumps 1kb of memory at the specified address */
void dump_mem(unsigned int addr)
{
	const int rowbytes = 32;

	for(int row = 0; row < 512/rowbytes; row++) {
		printk("@%08x ", addr + rowbytes*row);

		int *pi = (int *)(addr + row*rowbytes);
		char *pc = (char *)pi;
		for (int col = 0; col < (rowbytes / sizeof(int)); col++) {
			printk("%08x ", pi[col]);
		}
		for (int b = 0; b < rowbytes; b++) {
			char c = pc[b];
			printk("%c", c = c < ' ' ? '.' : (c > '~' ? '.' : c));
		}
		printk("\n");
	}
}

void check_write(volatile int *p)
{
	int val = *p;
	*p = 0x5a5a5a5a;
	*p = val;
}

void probe_imr(void)
{
	uint32_t addr, addr0 = 0x90000000;

	for(addr = addr0; addr < 0x90400000; addr += 4) {
		check_write((int *)addr);
	}
	printk("Probed IMR range [%p,%p]\n", (void*)addr0, (void*)(addr-4));

#if 0
	// This one fails and crashes the DSP, but recoverably (the next
	// firmware load boots OK)
	printk("Trying %p\n", addr0 - 4);
	check_write(addr0 - 4);

	// This one hangs the DSP solid and requries a power cycle to
	// recover.
	printk("Trying %p\n", (int *)addr);
	check_write((int *)addr);
#endif
}

void timecheck(void)
{
	unsigned int c0, c, n = 0;
	__asm__ volatile("rsr.ccount %0" : "=r"(c0));
	while(true) {
		__asm__ volatile("rsr.ccount %0" : "=r"(c));
		if (c - c0 > 400000000) {
			printk("%d\n", c);
			c0 = c;
			if (++n >= 5) {
				break;
			}
		}
	}
}

void busy_wait(unsigned int us)
{
	unsigned int cyc = us * 400;
	unsigned int t0, t1;
	__asm__ volatile("rsr.ccount %0" : "=r"(t0));
	do {
		__asm__ volatile("rsr.ccount %0" : "=r"(t1));
	} while (t1 - t0 < cyc);
}

/* Bounces around the power-of-two sized memory region specified doing
 * reads from random addresses (to evade any intervening caching or
 * prefetching), returning a cycle count for the 100k operations.
 * Mask must obviously have 1's in its lower bits.
 */
void membounce(unsigned int addr, unsigned int mask)
{
	unsigned int t0, t1, val = 29;
	busy_wait(10000);

	mask &= ~3;  // mask off bottom 2 bits for alignment
	__asm__ volatile("rsr.ccount %0" : "=r"(t0));
	for(int i = 0; i < 100000; i++) {
		volatile int *p = (void *)(addr + val);
		val = ((val ^ (*p)) * 1664525 + 1013904223) & mask;
	}
	__asm__ volatile("rsr.ccount %0" : "=r"(t1));

	unsigned int result = t1 - t0;
	printk("%d.%05d cyc/read\n", result / 100000, result % 100000);
}

void imr_walkbench(void)
{
	unsigned int t0, t1, val = 0, n = 1000000;
	volatile int *imr = (void *)0x90000000;

	__asm__ volatile("rsr.ccount %0" : "=r"(t0));
	for(int i=0; i<n; i++) {
		val += imr[i];
	}
	__asm__ volatile("rsr.ccount %0" : "=r"(t1));
	unsigned int result = t1 - t0;
	printk("%d.%06d cyc/read\n", result / 1000000, result % 1000000);
}

void mem_benchmark(void)
{
        printk("L1 cache bench: ");
        membounce(0xbe000000, 16*1024 - 1);
        printk("HP-SRAM bench: ");
        membounce(0x9e000000, 512*1024 - 1);
        printk("LP-SRAM bench: ");
        membounce(0x9e800000, 128*1024 - 1);

	// The IMR is behaving weirdly.  The first 64k seems reliably
	// fast, but the others can take 1000+ cycles per op.  That's
	// hundreds of refresh cycles of the underlying DRAM, it's
	// absolutely ridiculous.  It's like there's a tiny cache for
	// the first bit, but everything else... it's like it's
	// handled by a software interrupt somewhere.  Maybe there's a
	// TLB and we're taking page faults in something?  Note the
	// busy wait in membounce(), that seems to regularize the
	// behavior.
	printk("IMR bench (1st 64k): ");
	membounce(0x90000000, 0xffff);
	printk("          (2nd 64k): ");
	membounce(0x90010000, 0xffff);
	printk("          (3rd 64k): ");
	membounce(0x90020000, 0xffff);
	printk("          (1st 128k): ");
	membounce(0x90000000, 0xffff);
	printk("          (full): ");
	membounce(0x90000000, 0x3fffff);

	// Sequential walks are faster, but not super fast. Like
	// there's a prefetch buffer maybe?
	printk("IMR sequential walk: ");
	imr_walkbench();
}


void dump_misc_regs(void)
{
	extern char _memmap_vecbase_reset;
	u32_t vecbase;
	__asm__ volatile("rsr.vecbase %0" : "=r"(vecbase));
	printk("_memmap_vecbase_reset @ %p VECBASE %p\n",
	       &_memmap_vecbase_reset, (void*)vecbase);


	for(int w=0; w<4; w++) {
		printk("Window %d @%p limit offset %d\n",
		       w, *(void**)DMWBA(w), (*(int*)DMWLO(w))>>3);
	}
}


void dump_imr(void)
{
	// Dump and note that this region, unused by any DSP firmware,
        // contains precisely the CSME-iterpreted start of the rimage
        // file.  It just copies the thing blind.
        dump_mem(0xb0002000);
}

FUNC_NORETURN void cputop(void *data)
{
	printk("\n==\n== Second CPU!\n==\n");
	dump_misc_regs();
	check_cache();

	while(1) {
		for(volatile int i=0; i<10000000; i++);
		printk(".\n");
	}
}

void mp_check(void)
{
#if CONFIG_MP_NUM_CPUS > 1 && !defined(CONFIG_SMP)
        // Fire up the second CPU
	arch_start_cpu(1, stack, STACK_SIZE, cputop, NULL);
#endif
}

void main(void)
{
	k_busy_wait(500);
	printk("Hello World! %s [T%p]\n", CONFIG_BOARD, k_current_get());

	dump_misc_regs();
	//dump_imr();
        //probe_imr();
	//mem_benchmark();
        //timecheck();
	check_cache();
	mp_check();
}
```

## src/hda.c
```c
#include <zephyr.h>

#define HDA_BAR0 0xfebf0000
#define HDA_IRQ 11

/* Size (in transfer units) of the CORB/RIRB ring buffers.  The
 * interface specification only allows 2, 16 or 256, and specific
 * hardware may implement only a subset of those (qemu supports only
 * 256)
 */
#define RING_BUF_SIZE 256

/* How many buffers per stream */
#define NUM_BUFS 3

/* How many samples per buffer */
#define BUF_SAMPLES 128

/* Maximum number of codecs in a chain that defines a stream */
#define MAX_STREAM_CODECS 8

enum hda_regs {
	GCAP		= 0x00,	/* Global Capabilities (16 bit) */
	VMIN		= 0x02,	/* Minor Version (8 bit) */
	VMAJ		= 0x03,	/* Major Version (8 bit) */
	OUTPAY		= 0x04,	/* Output Payload Cap (16 bit) */
	INPAY		= 0x06,	/* Input Payload Cap (16 bit) */
	GCTL		= 0x08,	/* Global Control */
	WAKEEN		= 0x0C,	/* Wake Enable (16 bit) */
	WAKESTS		= 0x0E,	/* Wake Status (16 bit) */
	GSTS		= 0x10,	/* Global Status (16 bit) */
	OUTSTRMPAY	= 0x18,	/* Output Stream Payload Cap (16 bit) */
	INSTRMPAY	= 0x1A,	/* Input Stream Payload Cap (16 bit) */
	INTCTL		= 0x20,	/* Interrupt Control */
	INTSTS		= 0x24,	/* Interrupt Status */
	WALCLK		= 0x30,	/* Wall Clock Counter */
	SSYNC		= 0x38,	/* Stream Synchronization */
	CORBLBASE	= 0x40,	/* CORB Lower Base Address */
	CORBUBASE	= 0x44,	/* CORB Upper Base Address */
	CORBWP		= 0x48,	/* CORB Write Pointer (16 bit) */
	CORBRP		= 0x4A,	/* CORB Read Pointer (16 bit) */
	CORBCTL		= 0x4C,	/* CORB Control (8 bit) */
	CORBSTS		= 0x4D,	/* CORB Status (8 bit) */
	CORBSIZE	= 0x4E,	/* CORB Size (8 bit) */
	RIRBLBASE	= 0x50,	/* RIRB Lower Base Address */
	RIRBUBASE	= 0x54,	/* RIRB Upper Base Address */
	RIRBWP		= 0x58,	/* RIRB Write Pointer (16 bit) */
	RINTCNT		= 0x5A,	/* Response Interrupt Count (16 bit) */
	RIRBCTL		= 0x5C,	/* RIRB Control (8 bit) */
	RIRBSTS		= 0x5D,	/* RIRB Status (8 bit) */
	RIRBSIZE	= 0x5E,	/* RIRB Size (8 bit) */
	ICOI		= 0x60,	/* Imm. Command Output Interface */
	ICII		= 0x64,	/* Imm. Command Input Interface */
	ICIS		= 0x68,	/* Imm. Command Status (16 bit) */
	DPIBLBASE	= 0x70,	/* DMA Position Buffer Lower Base */
	DPIBUBASE	= 0x74,	/* DMA Position Buffer Upper Base */
};

enum stream_regs {
	STSCTL	= 0x0,
	LPIB	= 0x04,
	CBL	= 0x08,
	LVI	= 0x0c, /* 16 bit */
	FIFOS	= 0x10, /* 16 bit */
	FMT	= 0x12, /* 16 bit */
	BDPL	= 0x18,
	BDPU	= 0x1c,
};

enum codec_cmds {
	GET_NODE_PARAM = 0xf00,
	GET_CONN_ENTRY = 0xf02,
};

enum node_params {
	IDS = 0,
	REVISION = 0x02,
	NODE_COUNT = 0x04,
	FUNC_GROUP_TYPE = 0x05,
	AUD_GROUP_CAP = 0x08,
	AUD_WIDGET_CAP = 0x09,
	SUPP_PCM_RATES = 0x0a,
	SUPP_FORMATS = 0x0b,
	PIN_CAP = 0x0c,
	IN_AMP_CAP = 0x0d,
	CONN_LIST_LEN = 0x0e,
	SUPP_POWER_STATES = 0x0f,
	PROC_CAP = 0x10,
	GPIO_COUNT = 0x11,
	OUT_AMP_CAP = 0x12,
	VOL_CAP = 0x13,
};

#define HDA_REG8(r)  (*((volatile  u8_t *)(long)(HDA_BAR0 + r)))
#define HDA_REG16(r) (*((volatile u16_t *)(long)(HDA_BAR0 + r)))
#define HDA_REG32(r) (*((volatile u32_t *)(long)(HDA_BAR0 + r)))

#define STREAMREG(s, r) (0x80 + (s * 32) + r)

#define HDA_STREAM_REG8(s, r) HDA_REG8(STREAMREG(s, r))
#define HDA_STREAM_REG16(s, r) HDA_REG16(STREAMREG(s, r))
#define HDA_STREAM_REG32(s, r) HDA_REG32(STREAMREG(s, r))

struct buf_desc_entry {
	u64_t addr;
	u32_t len;
	u32_t interrupt; /* 1 = "interrupt on completion" */
}; // FIXME: aligned(128)!

struct stream_desc {
	/* Abstract assigned stream identifier, should be >= 1 */
	int stream_id;

	/* Index within stream register banks (unified, so a block of
	 * input streams have indices before the output streams before
	 * the bidirectional streams)
	 */
	int stream_idx;

	/* Which codec device's widgets are we using? */
	int codec_id;

	/* List of widgets to assemble into the chain, in order from
	 * the last sink (i.e. an output pin, or an input ADC link) to
	 * the original source (e.g. DAC link, microphone pin).  Node
	 * zero is never a widget (it's always a function group) so
	 * zeros are used to terminate the list.
	 */
	int widget_chain[MAX_STREAM_CODECS];

	struct stream_bufs *bufs;
};

struct stream_bufs {
	struct buf_desc_entry __aligned(128) buf_desc_list[NUM_BUFS];
	// FIXME: empty space misalignment right here
	unsigned short __aligned(128) bufs[NUM_BUFS][BUF_SAMPLES];
};

static struct stream_bufs out_stream_bufs;
static const struct stream_desc out_stream = {
	.stream_id = 1,
	.stream_idx = 4,
	.codec_id = 0,
	.widget_chain = { 3, 2 },
	.bufs = &out_stream_bufs,
};

static struct stream_bufs in_stream_bufs;
static const struct stream_desc in_stream = {
	.stream_id = 2,
	.stream_idx = 0,
	.codec_id = 0,
	.widget_chain = { 4, 5 },
	.bufs = &in_stream_bufs,
};

/* Hardware requires the buffers be aligned to 128 byte boundaries.
 * Note carefully that RIRB entries are TWICE the size of CORB
 * commands.
 */
static volatile u32_t __aligned(128) corb[RING_BUF_SIZE];
static volatile u64_t __aligned(128) rirb[RING_BUF_SIZE];

static int last_rirb;

static void enqueue_cmd(int codec, int node, int cmd, int data)
{
	u32_t val = (codec << 28) | (node << 20) | (cmd << 8) | data;
	int wp = (HDA_REG16(CORBWP) + 1) & (RING_BUF_SIZE - 1);

	corb[wp] = val;
	HDA_REG16(CORBWP) = wp;
}

/* spins waiting on a RIRB entry, returning its index (!) in rirb[].
 * Note that qith qemu, all codec operations are perfectly
 * synchronous, they happen inside the MMIO write to CORBWP.
 */
static int await_rirb(void)
{
	while (HDA_REG16(RIRBWP) == last_rirb) {
		k_busy_wait(1);
	}

	last_rirb = (last_rirb + 1) & (RING_BUF_SIZE - 1);
	return last_rirb;
}

static u64_t sync_codec_cmd(int codec, int node, int cmd, int data)
{
	/* NOTE: this is intolerant of existing commands in flight (it
	 * assume's we've transmitted everything) and of "unsolicited"
	 * out of band messages from the codecs.
	 */
	enqueue_cmd(codec, node, cmd, data);
	return rirb[await_rirb()];
}

/* Each output buffer implements an identical triangle wave over the
 * full buffer length.  With a 128 sample buffer at 48 kHz, that comes
 * out to a 375 Hz tone (roughly the F# above middle C).
 */
static void init_output_bufs(void)
{
	int val, halfway = BUF_SAMPLES / 2;

	for (int b = 0; b < NUM_BUFS; b++) {
		for (int i = 0; i < halfway; i++) {
			/* Increasing ramp */
			val = (0xffff * i) / halfway;
			out_stream_bufs.bufs[b][i] = val;
		}
		for (int i = 0; i + halfway < BUF_SAMPLES; i++) {
			/* Decreasing ramp */
			val = 0xffff - ((0xffff * i) / halfway);
			out_stream_bufs.bufs[b][halfway + i] = val;
		}
	}
}

static void enum_node(int codec, int node, int depth)
{
	int widget_type = 0;
	u64_t val;
	char prefix[16];
	for(int i=0; i<depth; i++) {
		prefix[2*i] = ' ';
		prefix[2*i+1] = ' ';
	}
	prefix[2*depth] = 0;
	printk("\n%s Codec%d Node%d (%s):\n", prefix, codec, node,
	       depth == 0 ? "root"
	       : (depth == 1 ? "function group" : "widget"));

	if (node == 0) {
		val = sync_codec_cmd(codec, node, GET_NODE_PARAM, IDS);
		printk("%s  Vendor ID = %xh\n", prefix, (int)val);
		val = sync_codec_cmd(codec, node, GET_NODE_PARAM, REVISION);
		printk("%s  Revision ID = %xh\n", prefix, (int)val);
	}

	if (depth == 1) {
		val = sync_codec_cmd(codec, node,
				     GET_NODE_PARAM, FUNC_GROUP_TYPE);
		printk("%s  Function Group Type = %xh\n", prefix, (int)val);

		val = sync_codec_cmd(codec, node,
				     GET_NODE_PARAM, AUD_GROUP_CAP);
		printk("%s  Audio Group Capabilities = %xh\n", prefix, (int)val);
	}

	if (depth > 1) {
		val = sync_codec_cmd(codec, node,
				     GET_NODE_PARAM, AUD_WIDGET_CAP);
		widget_type = (val >> 20) & 0xf;
		printk("%s  Audio Widget Capabilities = %xh (type: %xh)\n",
		       prefix, (int)val, widget_type);
	}

	if (depth != 0) {
		val = sync_codec_cmd(codec, node,
				     GET_NODE_PARAM, SUPP_PCM_RATES);
		if (val) {
			printk("%s  Supported PCM Rates = %xh\n", prefix, (int)val);
		}
		val = sync_codec_cmd(codec, node,
				     GET_NODE_PARAM, SUPP_FORMATS);
		if (val) {
			printk("%s  Supported Stream Formats = %xh\n",
			       prefix, (int)val);
		}
	}

	if (depth > 1 && widget_type == 4) {
		val = sync_codec_cmd(codec, node,
				     GET_NODE_PARAM, PIN_CAP);
		printk("%s  Pin Capabilities = %xh\n", prefix, (int)val);
	}

	for (int i = 0; depth > 0 && i < 2; i++) {
		int arg = i ? OUT_AMP_CAP : IN_AMP_CAP;
		val = sync_codec_cmd(codec, node,
				     GET_NODE_PARAM, arg);

		if (!val) {
			continue;
		}

		printk("%s  %sput Amplifier stepsz=%d nsteps=%d offset=%d%s\n",
		       prefix, i ? "Out" : "In", (int)((val >> 16) & 0x7f),
		       (int)((val >> 8) & 0x7f), (int)(val & 0x7f),
		       (val & (1 << 31)) ? " (mute works)" : "");
	}

	val = sync_codec_cmd(codec, node,
			     GET_NODE_PARAM, CONN_LIST_LEN);
	if (val > 0) {
		// FIXME: only supports fetching one connection!
		val = sync_codec_cmd(codec, node, GET_CONN_ENTRY, 0);
		printk("%s  Connections: [ %d ]\n", prefix, (int)val);
	}

	val = sync_codec_cmd(codec, node, GET_NODE_PARAM, SUPP_POWER_STATES);
	if (val) {
		printk("%s  Supported Power States: %xh\n", prefix, (int)val);
	}

	val = sync_codec_cmd(codec, node, GET_NODE_PARAM, PROC_CAP);
	if (val) {
		printk("%s  Processing Capabilities: %xh\n", prefix, (int)val);
	}

	val = sync_codec_cmd(codec, node, GET_NODE_PARAM, GPIO_COUNT);
	if (val) {
		printk("%s  GPIO Count: %xh\n", prefix, (int)val);
	}

	val = sync_codec_cmd(codec, node, GET_NODE_PARAM, VOL_CAP);
	if (val) {
		printk("%s  Volume Capabilties: %xh\n", prefix, (int)val);
	}

	/* Now enumerate children */
	val = sync_codec_cmd(codec, node, GET_NODE_PARAM, NODE_COUNT);

	int start_node = (val >> 16) & 0xff;
	int num_nodes = val & 0xff;

	for (int n = 0; n < num_nodes; n++) {
		enum_node(codec, start_node + n, depth + 1);
	}
}

static void dump_stream(int idx)
{
	printk(" STS/CTL=%xh", HDA_STREAM_REG32(idx, STSCTL));
	printk(" LPIB=%d", HDA_STREAM_REG32(idx, LPIB));
	printk(" CBL=%d", HDA_STREAM_REG32(idx, CBL));
	printk(" LVI=%d\n", HDA_STREAM_REG16(idx, LVI));
	printk(" FIFOS=%d", HDA_STREAM_REG16(idx, FIFOS));
	printk(" FMT=%xh", HDA_STREAM_REG16(idx, FMT));
	printk(" BDPL=%xh", HDA_STREAM_REG32(idx, BDPL));
	printk(" BDPU=%xh\n", HDA_STREAM_REG32(idx, BDPU));
}

/* Returns a sample format value in the bit format described for the
 * stream FMT registers.
 *
 * rate48: clock base, true for 48 kHz, false for 44.1
 * mul: clock multiplier, in the range 1-4
 * div: clock divisor, in the range 1-8
 * bits: bits per sample, one of {8, 16, 20, 24, 32}
 * n_chans: number of channels in the stream, in the range 1-16
 */
static u16_t sample_format(bool rate48, int mul, int div,
			   int bits, int n_chans)
{
	u16_t ret = rate48 ? 0 : (1 << 14);

	ret |= ((mul - 1) << 11);
	ret |= ((div - 1) << 8);
	ret |= (n_chans - 1);

	u16_t bitsfld;
	switch (bits) {
	case 8: bitsfld = 0; break;
	case 20: bitsfld = 2; break;
	case 24: bitsfld = 3; break;
	case 32: bitsfld = 4; break;
	default: bitsfld = 1; break; /* 16 bit samples */
	};

	ret |= bitsfld << 4;

	return ret;
}

static void init_stream(const struct stream_desc *s)
{
	int si = s->stream_idx;

	/* Reset: write a 1 to the low bit of CTL, wait for it to
	 * appear in a read, then set it to zero and wait for that to
	 * appear
	 */
	// FIXME unifiy with other reset sequence
	HDA_STREAM_REG32(si, STSCTL) |= 1;
	while ((HDA_STREAM_REG32(si, STSCTL) & 1) == 0) {
	}
	HDA_STREAM_REG32(si, STSCTL) &= ~1;
	while ((HDA_STREAM_REG32(si, STSCTL) & 1) != 0) {
	}

	/* Set stream ID */
	// FIXME: also need to set interrupt enable here, and
	// bidirectional stream direction where applicable.
	HDA_STREAM_REG32(si, STSCTL) |= (s->stream_id << 20);

	HDA_STREAM_REG16(si, FMT) = sample_format(true, 1, 1, 16, 2);

	/* Buffer descriptor pointer & buffer count */
	for (int i = 0; i < NUM_BUFS; i++) {
		s->bufs->buf_desc_list[i].addr = (long) &s->bufs[i];
		s->bufs->buf_desc_list[i].len = BUF_SAMPLES * 2;
		s->bufs->buf_desc_list[i].interrupt = 0;
	}

	u64_t bdl = (long) &s->bufs->buf_desc_list;
	HDA_STREAM_REG32(si, BDPL) = bdl & 0xffffffff;
	HDA_STREAM_REG32(si, BDPU) = bdl >> 32;
	HDA_STREAM_REG16(si, LVI) = NUM_BUFS - 1;
	HDA_STREAM_REG16(si, CBL) = NUM_BUFS * BUF_SAMPLES * 2;

	/* Now initialize the individual widgets */
	for (int i = 0; s->widget_chain[i] != 0; i++) {
		int w = s->widget_chain[i];

		// FIXME: exactly how to detect what needs to be done?
		// SetPinWidgetControl cmd to pins
		// SetStreamChannel to DAC
		// SetPowerState to DAC
		// SetAmplifierGain to DAC
	}
}

void hda_test(void)
{
	/* Reset the device by pulsing low bit of GCTL */
	// FIXME unifiy with other reset sequence
	HDA_REG32(GCTL) = 0;
	while ((HDA_REG32(GCTL) & 1) != 0) {
	}
	HDA_REG32(GCTL) = 1;
	while ((HDA_REG32(GCTL) & 1) == 0) {
	}

	int szbits = RING_BUF_SIZE == 256 ? 2 : (RING_BUF_SIZE == 16 ? 1 : 0);

	/* Initialize the CORB, note the dance required by the spec to
	 * reset the Read Pointer register: write a 1 to the high bit,
	 * read it back, then set it back to zero and read back.  The
	 * last step enables the DMA engine.
	 */
	HDA_REG32(CORBLBASE) = (u32_t)(long)&corb[0];
	HDA_REG32(CORBUBASE) = 0;
	HDA_REG8(CORBSIZE) = szbits;
	HDA_REG16(CORBWP) = 0;
	HDA_REG16(CORBRP) = 0x8000;
	while ((HDA_REG16(CORBRP) & 0x8000) == 0) {
		k_busy_wait(1);
	}
	HDA_REG16(CORBRP) = 0;
	while (HDA_REG16(CORBRP) != 0) {
		k_busy_wait(1);
	}
	HDA_REG8(CORBCTL) = 0x2; /* Enable DMA */
	while ((HDA_REG8(CORBCTL) & 0x2) == 0) {
	}

	/* The RIRB initializes similarly, but the "Read Pointer" is
	 * our side (implemented in software) so there is no register.
	 */
	HDA_REG32(RIRBLBASE) = (u32_t)(long)&rirb[0];
	HDA_REG16(RIRBUBASE) = 0;
	HDA_REG16(RIRBWP) = 0;
	HDA_REG8(RIRBSIZE) = szbits;
	HDA_REG8(RIRBCTL) = 0x2;

	/* HDA allows for an interrupt to be delivered after this many
	 * RIRB entries have been queued (presumably as a mechanism to
	 * prevent overruns).  Qemu, seemingly contrary to the docs,
	 * will actually STALL THE DEVICE when this limit is reached
	 * until something resets the interrupt status bit (i.e. until
	 * it thinks an ISR has serviced the requests).  So on qemu,
	 * it's required that this have a non-zero value, otherwise it
	 * looks "full" with its default value of zero and nothing
	 * happens.
	 */
	HDA_REG16(RINTCNT) = 0xff;

	/********************************************************************/
	/* Debug code to dump state: */

	printk("\n*** HDA ***\n");

	printk("GCAP %xh VER %d.%d\n",
	       HDA_REG16(GCAP), HDA_REG8(VMAJ), HDA_REG8(VMIN));
	printk("WAKESTS %xh\n", HDA_REG16(WAKESTS));
	printk("GCTL %xh GSTS %xh INTCTL %xh INTSTS %xh\n",
	       HDA_REG32(GCTL), HDA_REG16(GSTS),
	       HDA_REG32(INTCTL), HDA_REG32(INTSTS));
	printk("ICIS %xh\n", HDA_REG16(ICIS));

	/* Seems like on qemu, the WALCLK register ticks 4x slower
	 * than the TSC.
	 */
	u32_t wc0 = HDA_REG32(WALCLK), cyc0 = k_cycle_get_32();
	for (int i=0; i<4; i++) {
		printk("  WALCLK %d cyc %d\n",
		       HDA_REG32(WALCLK) - wc0, k_cycle_get_32() - cyc0);
	}

	printk("CORB BASE %x:%xh (&corb[0] %p)\n", HDA_REG32(CORBUBASE), HDA_REG32(CORBLBASE), &corb[0]);
	printk("CORBWP %d CORBRP %d CORBCTL %xh CORBSTS %xh CORBSIZE %xh\n",
	       HDA_REG16(CORBWP), HDA_REG16(CORBRP), HDA_REG8(CORBCTL),
	       HDA_REG8(CORBSTS), HDA_REG8(CORBSIZE));

	printk("RIRBWP %d RIRBCTL %xh RIRBSTS %xh RIRBSIZE %xh\n",
	       HDA_REG16(RIRBWP), HDA_REG8(RIRBCTL),
	       HDA_REG8(RIRBSTS), HDA_REG8(RIRBSIZE));
	printk("RIRB BASE %x:%xh (&rirb[0] %p)\n", HDA_REG32(RIRBUBASE), HDA_REG32(RIRBLBASE), &rirb[0]);

	/* Dump stream registers */
	u32_t gcap = HDA_REG16(GCAP);
	int stream_idx = 0;

	for (int i = 0; i < ((gcap >> 12) & 0xf); i++) {
		printk("Input Stream (idx %d)\n", stream_idx);
		dump_stream(stream_idx++);
	}
	for (int i = 0; i < ((gcap >> 8) & 0xf); i++) {
		printk("Output Stream (idx %d)\n", stream_idx);
		dump_stream(stream_idx++);
	}
	for (int i = 0; i < ((gcap >> 12) & 0xf); i++) {
		printk("Bidirectional Stream (idx %d)\n", stream_idx);
		dump_stream(stream_idx++);
	}

	for (int c = 0; c < 16; c++) {
		if ((HDA_REG16(WAKESTS) & (1 << c)) != 0) {
			enum_node(c, 0, 0);
		}
	}

	init_output_bufs();
	init_stream(&in_stream);
	init_stream(&out_stream);
}
```
