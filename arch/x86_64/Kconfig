## boards/arm/mps2_an385/Kconfig.board
```kconfig
#
# Copyright (c) 2017 Linaro Limited
#
# SPDX-License-Identifier: Apache-2.0
#

# Note: the MPS2 is a real hardware board, but this target runs under
# qemu as part of our test suite and needs to be compiled with the
# relevant workarounds.

config BOARD_MPS2_AN385
	select QEMU_TICKLESS_WORKAROUND
	bool "ARM Cortex-M3 SMM on V2M-MPS2 (Application Note AN385)"
	depends on SOC_MPS2_AN385
```

## boards/x86/up_squared/up_squared_defconfig
```kconfig
# SPDX-License-Identifier: Apache-2.0

CONFIG_SYS_CLOCK_HW_CYCLES_PER_SEC=19200000
CONFIG_SOC_APOLLO_LAKE=y
CONFIG_BOARD_UP_SQUARED=y
CONFIG_PIC_DISABLE=y
CONFIG_LOAPIC=y
CONFIG_CONSOLE=y
CONFIG_SERIAL=y
CONFIG_UART_NS16550=y
CONFIG_UART_CONSOLE=y
CONFIG_I2C=y
CONFIG_X2APIC=y
CONFIG_X86_MMU=y
CONFIG_DEBUG_INFO=y
CONFIG_SCHED_SCALABLE=y
CONFIG_WAITQ_SCALABLE=y
CONFIG_X86_VERY_EARLY_CONSOLE=y
CONFIG_X86_64=y
CONFIG_SMP=y
CONFIG_MP_NUM_CPUS=2
CONFIG_HPET_TIMER=y
```

## boards/x86_64/qemu_x86_64/qemu_x86_64_defconfig
```kconfig
CONFIG_X86_64=y
CONFIG_SOC_X86_64=y
CONFIG_BOARD_QEMU_X86_64=y
CONFIG_CONSOLE=y
CONFIG_SERIAL=y
CONFIG_SYS_CLOCK_HW_CYCLES_PER_SEC=1000000000
CONFIG_TEST_RANDOM_GENERATOR=y
CONFIG_XIP=y
```

## samples/net/sockets/big_http_download/sample.yaml
```yaml
sample:
  description: BSD Sockets big HTTP download example
  name: big_http_download
tests:
  test:
    filter: CONFIG_NEWLIB_LIBC_AVAILABLE
    harness: net
    min_ram: 32
    tags: net
```

## samples/net/sockets/dumb_http_server/sample.yaml
```yaml
sample:
  description: BSD Sockets API dumb HTTP server example
  name: socket_dumb_http_server
tests:
  test:
    filter: CONFIG_NEWLIB_LIBC_AVAILABLE
    harness: net
    min_ram: 32
    tags: net
```

## samples/net/sockets/http_get/sample.yaml
```yaml
sample:
  description: BSD Sockets API HTTP GET example
  name: socket_http_get
tests:
  test:
    filter: CONFIG_NEWLIB_LIBC_AVAILABLE
    harness: net
    min_ram: 32
    tags: net
```

## soc/x86_64/x86_64/Kconfig.defconfig
```kconfig
if SOC_X86_64

config SOC
	default "x86_64"

config USE_SWITCH
	default y

# We aren't part of the SDK yet, so default this to false so CI knows
# not to try the newlib tests.
config NEWLIB_LIBC_AVAILABLE
	default n

endif
```

## tests/lib/mem_alloc/testcase.yaml
```yaml
tests:
  libraries.libc.minimal:
    extra_args: CONF_FILE=prj.conf
    arch_exclude: posix
    tags: clib minimal_libc
  libraries.libc.newlib:
    extra_args: CONF_FILE=prj_newlib.conf
    filter: CONFIG_NEWLIB_LIBC_AVAILABLE
    tags: clib newlib
```
